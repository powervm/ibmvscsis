## drivers/block/nvme-fabrics/Kconfig
```kconfig
config NVME_FABRICS
	tristate "NVMe Fabrics Project: default to m to force inclusion"
	default y
	---help---
	 TODO: FILL ME OUT
```

## drivers/nvme/target/Kconfig
```kconfig
config NVME_TARGET
	depends on BLOCK
	depends on CONFIGFS_FS
	tristate

config NVME_TARGET_LOOP
	tristate "NVMe loopback device support"
	depends on BLK_DEV_NVME
	select NVME_TARGET
	select NVME_FABRICS
	help
	  This enabled the NVMe loopback device support, which can be useful
	  to test NVMe host and target side features.

	  If unsure, say N.

config NVME_TARGET_RDMA
	tristate "NVMe over Fabrics RDMA target support"
	depends on INFINIBAND
	select NVME_TARGET
```
